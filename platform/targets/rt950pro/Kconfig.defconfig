## platform/targets/rt950pro/Kconfig.defconfig
```kconfig
# SPDX-FileCopyrightText: Copyright 2020-2026 OpenRTX Contributors
#
# SPDX-License-Identifier: GPL-3.0-or-later

if BOARD_RT950PRO

config BOARD_EARLY_INIT_HOOK
	default y

endif # BOARD_RT950PRO
```

## platform/targets/rt950pro/board.yml
```yaml
# SPDX-FileCopyrightText: Copyright 2020-2026 OpenRTX Contributors
#
# SPDX-License-Identifier: GPL-3.0-or-later

board:
  name: rt950pro
  full_name: Radtel RT-950 Pro
  socs:
    - name: at32f403a
```

## west.yml
```yaml
# SPDX-License-Identifier: GPL-3.0-or-later
# SPDX-FileCopyrightText: Copyright 2020-2026 OpenRTX Contributors
#
# This file is part of OpenRTX.

manifest:
  self:
    path: OpenRTX

  defaults:
    remote: zephyr

  group-filter:
    - -csk6
    - -esp32
    - -artery

  remotes:
    - name: openrtx
      url-base: https://github.com/OpenRTX

    - name: zephyr
      url-base: https://github.com/zephyrproject-rtos

    - name: artery
      url-base: https://github.com/ArteryTek

  projects:
    # Zephyr mainline modules
    - name: zephyr
      remote: zephyr
      revision: a4de2eb3d1756c445d2e2ecb72e6d562674c118b
      path: zephyr
      west-commands: scripts/west-commands.yml
      groups:
        - esp32

    - name: mcuboot
      remote: zephyr
      revision: 9bf7ce8c5fe8152836a6e00bd4444153bd950342
      path: bootloader/mcuboot
      groups:
        - esp32

    - name: hal_espressif
      remote: zephyr
      revision: 80d910ca89eab9bce03f59a4ade33f1fc30ce0ad
      path: modules/hal/espressif
      west-commands: west/west-commands.yml
      groups:
        - esp32

    - name: cmsis
      remote: zephyr
      repo-path: cmsis
      revision: 74981bf893e8b10931464b9945e2143d99a3f0a3
      path: modules/hal/cmsis
      groups:
        - csk6

    # ListenAI fork-specific modules
    - name: listenai-zephyr
      remote: openrtx
      repo-path: listenai-zephyr
      revision: b8fcc47cc045871d5127a78a77b3f30feb65e8cd
      path: zephyr-listenai
      west-commands: scripts/west-commands.yml
      groups:
        - csk6

    - name: listenai-csk
      remote: openrtx
      repo-path: listenai-csk
      revision: f097b7f9dfe4aba9fae08af787230e023ee21aa0
      path: csk
      groups:
        - csk6

    - name: listenai-hal
      remote: openrtx
      repo-path: csk6_cm33
      revision: 9444f3dc2abec4d49e5daa6112a798ee43999222
      path: modules/hal/listenai/csk6_cm33
      groups:
        - csk6

    - name: listenai-modules-af
      remote: openrtx
      revision: openrtx-c62
      path: modules/lib/af
      groups:
        - csk6

    - name: listenai-modules-freertos_shims
      remote: openrtx
      revision: openrtx-c62
      path: modules/lib/freertos_shims
      groups:
        - csk6

    - name: listenai-modules-lsf
      remote: openrtx
      revision: openrtx-c62
      path: modules/lib/lsf
      groups:
        - csk6

    - name: listenai-modules-urpc
      remote: openrtx
      revision: openrtx-c62
      path: modules/lib/urpc
      groups:
        - csk6

    # Artery fork-specific modules (AT32F403A, Radtel RT-950 Pro).
    # The hal_at32 and cmsis_6 revisions match the ones pinned by the
    # west.yml of the Artery Zephyr fork itself.
    - name: artery-zephyr
      remote: artery
      repo-path: zephyr
      revision: 456548bdfa9b4c9ca399a00593c64214d3c96a39
      path: zephyr-artery
      groups:
        - artery

    - name: hal_at32
      remote: artery
      revision: c6b6c1dad423e9e8ad0d20e4dd7afc2bb5516638
      path: modules/hal/at32
      groups:
        - artery

    - name: cmsis_6
      remote: zephyr
      repo-path: CMSIS_6
      revision: 30a859f44ef8ab4dc8f84b03ed586fd16ccf9d74
      path: modules/hal/cmsis_6
      groups:
        - artery
```
